## package/libnvme/Config.in
```kconfig
config BR2_PACKAGE_LIBNVME
	bool "libnvme"
	depends on BR2_USE_MMU # malloc_usable_size()
	help
	  libnvme provides type definitions for NVMe specification
	  and utilities for nvme devices handling in Linux.

	  https://github.com/linux-nvme/libnvme

if BR2_PACKAGE_LIBNVME

config BR2_PACKAGE_LIBNVME_EXAMPLES
	bool "libnvme examples"
	default n
	help
	  Include the example from libnvme

endif
```

## package/mctp/Config.in
```kconfig
config BR2_PACKAGE_MCTP
	bool "mctp"
	depends on BR2_TOOLCHAIN_HEADERS_AT_LEAST_5_18
	help
	  This project contains two utilities for running a MCTP network from
	  the local machine:
	  
	    * mctp: A small command-line utility to query and manage the state
	      of the kernel MCTP stack, in a similar way to iproute2's ip utility.
	  
	    * mctpd: A daemon implementing the MCTP control protocol; you'll
	      need this for the local host to perform as a bus-owner. The main
	      function of mctpd is to assign EIDs to remote endpoints, and
	      manage the resulting routes and neighbour-table entries for those
	      endpoints.

comment "mctp needs a toolchain w/ headers >= 5.18"
	depends on !BR2_TOOLCHAIN_HEADERS_AT_LEAST_5_18
```
